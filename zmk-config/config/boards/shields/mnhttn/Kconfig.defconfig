## zmk-config/config/boards/shields/mnhttn/Kconfig.defconfig
```kconfig
# Copyright (c) 2022 The ZMK Contributors
# SPDX-License-Identifier: MIT

if SHIELD_MNHTTN_LEFT

config ZMK_KEYBOARD_NAME
    default "MNHTTN"
    
config ZMK_SPLIT_ROLE_CENTRAL
    default y

endif

if SHIELD_MNHTTN_LEFT || SHIELD_MNHTTN_RIGHT

config ZMK_SPLIT
    default y

endif
```

## zmk-config/config/boards/shields/mnhttn/Kconfig.shield
```kconfig
# Copyright (c) 2022 The ZMK Contributors
# SPDX-License-Identifier: MIT

config SHIELD_MNHTTN_LEFT
    def_bool $(shields_list_contains,mnhttn_left)

config SHIELD_MNHTTN_RIGHT
    def_bool $(shields_list_contains,mnhttn_right)
```
