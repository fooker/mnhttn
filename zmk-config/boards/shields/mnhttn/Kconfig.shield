## zmk-config/boards/shields/mnhttn/Kconfig.shield
```kconfig
# Copyright (c) 2026 The ZMK Contributors
# SPDX-License-Identifier: MIT

config SHIELD_MNHTTN_LEFT
    def_bool $(shields_list_contains,mnhttn_left)

config SHIELD_MNHTTN_RIGHT
    def_bool $(shields_list_contains,mnhttn_right)
```
